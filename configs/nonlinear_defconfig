## configs/nonlinear_defconfig
```kconfig
BR2_arm=y
BR2_cortex_a8=y
BR2_CCACHE=y
BR2_OPTIMIZE_3=y
BR2_PACKAGE_HOST_LINUX_HEADERS_CUSTOM_4_4=y
BR2_TOOLCHAIN_BUILDROOT_GLIBC=y
BR2_GCC_VERSION_5_X=y
BR2_EXTRA_GCC_CONFIG_OPTIONS="--with-fpu=vfpv3 --with-float=hard"
BR2_TOOLCHAIN_BUILDROOT_CXX=y
BR2_PACKAGE_HOST_GDB=y
BR2_GENERATE_LOCALE="en_US"
BR2_TARGET_GENERIC_HOSTNAME="nonlinux"
BR2_TARGET_GENERIC_ISSUE="Nonlinux by Nonlinear-Labs"
BR2_INIT_SYSTEMD=y
BR2_SYSTEM_BIN_SH_BASH=y
BR2_ROOTFS_OVERLAY="nonlinear/fs-overlay"
BR2_ROOTFS_POST_BUILD_SCRIPT="nonlinear/scripts/run.sh"
BR2_LINUX_KERNEL=y
BR2_LINUX_KERNEL_CUSTOM_VERSION=y
BR2_LINUX_KERNEL_CUSTOM_VERSION_VALUE="4.4.16"
BR2_LINUX_KERNEL_PATCH="nonlinear/patches/linux/01-linux-3.13.6-add-gpio-keys-to-devicetree.patch"
BR2_LINUX_KERNEL_USE_CUSTOM_CONFIG=y
BR2_LINUX_KERNEL_CUSTOM_CONFIG_FILE="nonlinear/config/linux-3.18.4"
BR2_LINUX_KERNEL_UIMAGE=y
BR2_LINUX_KERNEL_UIMAGE_LOADADDR="0x80800000"
BR2_LINUX_KERNEL_INSTALL_TARGET=y
BR2_PACKAGE_BUSYBOX_SELINUX=y
BR2_PACKAGE_GDB=y
BR2_PACKAGE_GDB_SERVER=y
BR2_PACKAGE_GDB_DEBUGGER=y
BR2_PACKAGE_GDB_TUI=y
BR2_PACKAGE_BINUTILS=y
BR2_PACKAGE_BINUTILS_TARGET=y
BR2_PACKAGE_E2FSPROGS=y
BR2_PACKAGE_LINUX_FIRMWARE=y
BR2_PACKAGE_LINUX_FIRMWARE_RALINK_RT61=y
BR2_PACKAGE_LINUX_FIRMWARE_RALINK_RT73=y
BR2_PACKAGE_LINUX_FIRMWARE_RALINK_RT2XX=y
BR2_PACKAGE_LINUX_FIRMWARE_RTL_81XX=y
BR2_PACKAGE_LINUX_FIRMWARE_RTL_87XX=y
BR2_PACKAGE_I2C_TOOLS=y
BR2_PACKAGE_FREETYPE=y
BR2_PACKAGE_DTC=y
BR2_PACKAGE_DTC_PROGRAMS=y
BR2_PACKAGE_TSLIB=y
BR2_PACKAGE_LIBSOUP=y
BR2_PACKAGE_LIBSOUP_SSL=y
BR2_PACKAGE_ELFUTILS=y
BR2_PACKAGE_GLIBMM=y
BR2_PACKAGE_SHARED_MIME_INFO=y
BR2_PACKAGE_AVAHI=y
# BR2_PACKAGE_AVAHI_AUTOIPD is not set
BR2_PACKAGE_BRIDGE_UTILS=y
BR2_PACKAGE_DHCP=y
BR2_PACKAGE_DHCP_SERVER=y
BR2_PACKAGE_ETHTOOL=y
BR2_PACKAGE_HOSTAPD=y
BR2_PACKAGE_HOSTAPD_EAP=y
BR2_PACKAGE_HOSTAPD_WPS=y
BR2_PACKAGE_IW=y
BR2_PACKAGE_OPENSSH=y
BR2_PACKAGE_WIRELESS_TOOLS=y
BR2_PACKAGE_WIRELESS_TOOLS_LIB=y
BR2_PACKAGE_WPA_SUPPLICANT=y
BR2_PACKAGE_WPA_SUPPLICANT_AP_SUPPORT=y
BR2_PACKAGE_WPA_SUPPLICANT_EAP=y
BR2_PACKAGE_WPA_SUPPLICANT_WPS=y
BR2_PACKAGE_WPA_SUPPLICANT_CLI=y
BR2_PACKAGE_WPA_SUPPLICANT_PASSPHRASE=y
BR2_PACKAGE_UTIL_LINUX_LOGIN_UTILS=y
BR2_PACKAGE_PLAYGROUND=y
BR2_PACKAGE_ESPI_DRIVER=y
BR2_PACKAGE_LPC_BB_DRIVER=y
BR2_TARGET_ROOTFS_TAR_GZIP=y
BR2_TARGET_UBOOT=y
BR2_TARGET_UBOOT_BOARDNAME="am335x_evm"
BR2_TARGET_UBOOT_FORMAT_IMG=y
BR2_TARGET_UBOOT_SPL=y
BR2_TARGET_UBOOT_SPL_NAME="MLO"
BR2_PACKAGE_HOST_DTC=y
BR2_PACKAGE_HOST_MKE2IMG=y
BR2_PACKAGE_HOST_UTIL_LINUX=y
```

## configs/nonlinear_usb_os_restore_defconfig
```kconfig
BR2_arm=y
BR2_cortex_a8=y
BR2_PRIMARY_SITE="http://sources.buildroot.net"
BR2_CCACHE=y
BR2_OPTIMIZE_3=y
BR2_KERNEL_HEADERS_4_4=y
BR2_TOOLCHAIN_BUILDROOT_GLIBC=y
BR2_GLIBC_VERSION_2_23=y
BR2_GCC_VERSION_5_X=y
BR2_EXTRA_GCC_CONFIG_OPTIONS="--with-fpu=vfpv3 --with-float=hard"
BR2_TOOLCHAIN_BUILDROOT_CXX=y
BR2_GENERATE_LOCALE="en_US"
BR2_TARGET_GENERIC_HOSTNAME="nonlinux"
BR2_TARGET_GENERIC_ISSUE="Nonlinux by Nonlinear-Labs"
BR2_INIT_SYSTEMD=y
BR2_SYSTEM_BIN_SH_BASH=y
BR2_ROOTFS_OVERLAY="nonlinear/fs-overlay-usb-os-restore"
BR2_LINUX_KERNEL=y
BR2_LINUX_KERNEL_CUSTOM_GIT=y
BR2_LINUX_KERNEL_CUSTOM_REPO_URL="https://github.com/nonlinear-labs-dev/linux.git"
#BR2_LINUX_KERNEL_CUSTOM_REPO_VERSION="nonlinear-am33xx-4.4.50"
BR2_LINUX_KERNEL_CUSTOM_REPO_VERSION="e02b6242a72c1cc81d4aec8153897efdab2e6ec8"
BR2_LINUX_KERNEL_DEFCONFIG="nonlinear"
BR2_LINUX_KERNEL_UIMAGE=y
BR2_LINUX_KERNEL_UIMAGE_LOADADDR="0x80008000"
BR2_LINUX_KERNEL_DTS_SUPPORT=y
BR2_LINUX_KERNEL_INTREE_DTS_NAME="am335x-boneblack"
BR2_PACKAGE_BUSYBOX_SELINUX=y
BR2_PACKAGE_BZIP2=y
BR2_PACKAGE_LINUX_FIRMWARE=y
BR2_PACKAGE_LINUX_FIRMWARE_RALINK_RT61=y
BR2_PACKAGE_LINUX_FIRMWARE_RALINK_RT73=y
BR2_PACKAGE_LINUX_FIRMWARE_RALINK_RT2XX=y
BR2_PACKAGE_LINUX_FIRMWARE_RTL_81XX=y
BR2_PACKAGE_LINUX_FIRMWARE_RTL_87XX=y
BR2_PACKAGE_AVRDUDE=y
BR2_PACKAGE_FREETYPE=y
BR2_PACKAGE_DTC=y
BR2_PACKAGE_DTC_PROGRAMS=y
BR2_PACKAGE_TSLIB=y
BR2_PACKAGE_LIBSOUP=y
BR2_PACKAGE_LIBSOUP_SSL=y
BR2_PACKAGE_GLIBMM=y
BR2_PACKAGE_NCURSES_TARGET_PANEL=y
BR2_PACKAGE_NCURSES_TARGET_FORM=y
BR2_PACKAGE_NCURSES_TARGET_MENU=y
BR2_PACKAGE_DHCP=y
BR2_PACKAGE_DHCP_SERVER=y
BR2_PACKAGE_HOSTAPD=y
BR2_PACKAGE_HOSTAPD_EAP=y
BR2_PACKAGE_HOSTAPD_WPS=y
BR2_PACKAGE_IW=y
BR2_PACKAGE_NETWORK_MANAGER=y
BR2_PACKAGE_OPENSSH=y
BR2_PACKAGE_RSYNC=y
BR2_PACKAGE_SOCAT=y
BR2_PACKAGE_SSHPASS=y
BR2_PACKAGE_THTTPD=y
BR2_PACKAGE_WPA_SUPPLICANT=y
BR2_PACKAGE_WPA_SUPPLICANT_AP_SUPPORT=y
BR2_PACKAGE_WPA_SUPPLICANT_EAP=y
BR2_PACKAGE_WPA_SUPPLICANT_HOTSPOT=y
BR2_PACKAGE_WPA_SUPPLICANT_DEBUG_SYSLOG=y
BR2_PACKAGE_WPA_SUPPLICANT_WPS=y
BR2_PACKAGE_WPA_SUPPLICANT_CLI=y
BR2_PACKAGE_WPA_SUPPLICANT_WPA_CLIENT_SO=y
BR2_PACKAGE_WPA_SUPPLICANT_PASSPHRASE=y
BR2_PACKAGE_WPA_SUPPLICANT_DBUS_OLD=y
BR2_PACKAGE_WPA_SUPPLICANT_DBUS_NEW=y
BR2_PACKAGE_WPA_SUPPLICANT_DBUS_INTROSPECTION=y
BR2_PACKAGE_UTIL_LINUX_LOGIN_UTILS=y
BR2_PACKAGE_ESPI_DRIVER=y
BR2_PACKAGE_PLAYCONTROLLER_DRIVER=y
BR2_PACKAGE_MXLI=y
BR2_PACKAGE_NLIMAGEMAKER=y
BR2_TARGET_ROOTFS_INITRAMFS=y
BR2_TARGET_UBOOT=y
BR2_TARGET_UBOOT_BUILD_SYSTEM_KCONFIG=y
BR2_TARGET_UBOOT_CUSTOM_GIT=y
BR2_TARGET_UBOOT_CUSTOM_REPO_URL="https://github.com/nonlinear-labs-dev/u-boot.git"
BR2_TARGET_UBOOT_CUSTOM_REPO_VERSION="nonlinear_v2016.11"
BR2_TARGET_UBOOT_BOARD_DEFCONFIG="nonlinear"
BR2_TARGET_UBOOT_FORMAT_IMG=y
BR2_TARGET_UBOOT_SPL=y
BR2_TARGET_UBOOT_SPL_NAME="MLO"
BR2_PACKAGE_HOST_DTC=y
BR2_PACKAGE_HOST_MKE2IMG=y
BR2_PACKAGE_HOST_UBOOT_TOOLS=y
BR2_PACKAGE_HOST_UTIL_LINUX=y
```

## configs/nonlinear_usbrescue_defconfig
```kconfig
BR2_arm=y
BR2_cortex_a8=y
BR2_CCACHE=y
BR2_KERNEL_HEADERS_4_4=y
BR2_TOOLCHAIN_BUILDROOT_GLIBC=y
BR2_GCC_VERSION_5_X=y
BR2_TARGET_GENERIC_ISSUE="Nonlinux by Nonlinear-Labs"
BR2_ROOTFS_OVERLAY="nonlinear/fs-overlay-usbrescue"
BR2_LINUX_KERNEL=y
BR2_LINUX_KERNEL_CUSTOM_GIT=y
BR2_LINUX_KERNEL_CUSTOM_REPO_URL="git@github.com:nonlinear-labs-dev/linux.git"
BR2_LINUX_KERNEL_CUSTOM_REPO_VERSION="nonlinear-am33xx-4.4.50"
BR2_LINUX_KERNEL_DEFCONFIG="nonlinear"
BR2_LINUX_KERNEL_UIMAGE=y
BR2_LINUX_KERNEL_UIMAGE_LOADADDR="0x80008000"
BR2_LINUX_KERNEL_DTS_SUPPORT=y
BR2_LINUX_KERNEL_INTREE_DTS_NAME="am335x-boneblack"
BR2_PACKAGE_DOSFSTOOLS=y
BR2_PACKAGE_DOSFSTOOLS_MKFS_FAT=y
BR2_PACKAGE_E2FSPROGS=y
BR2_PACKAGE_UBOOT_TOOLS=y
BR2_PACKAGE_UTIL_LINUX_BINARIES=y
BR2_PACKAGE_UTIL_LINUX_LSBLK=y
BR2_PACKAGE_UTIL_LINUX_SFDISK=y
BR2_PACKAGE_ESPI_DRIVER=y
BR2_PACKAGE_NLIMAGEMAKER=y
BR2_TARGET_ROOTFS_INITRAMFS=y
BR2_TARGET_UBOOT=y
BR2_TARGET_UBOOT_BUILD_SYSTEM_KCONFIG=y
BR2_TARGET_UBOOT_CUSTOM_GIT=y
BR2_TARGET_UBOOT_CUSTOM_REPO_URL="git@nonlinear-labs.git.beanstalkapp.com:/nonlinear-labs/u-boot.git"
BR2_TARGET_UBOOT_CUSTOM_REPO_VERSION="nonlinear_v2016.11"
BR2_TARGET_UBOOT_BOARD_DEFCONFIG="nonlinear"
BR2_TARGET_UBOOT_FORMAT_IMG=y
BR2_TARGET_UBOOT_SPL=y
BR2_TARGET_UBOOT_SPL_NAME="MLO"
```

## package/nonlinear/C15/Config.in
```kconfig
config BR2_PACKAGE_C15
       bool "C15"
       depends on BR2_PACKAGE_BOOST 
       depends on BR2_PACKAGE_ALSA_LIB
       help
         the NonlinearLabs C15 project
	 
	 http://www.nonlinear-labs.de
```

## package/nonlinear/bbbrtc/Config.in
```kconfig
config BR2_PACKAGE_BBBRTC
       bool "bbbrtc"
       help
         power cycle the BBB - https://github.com/bigjosh/bbbrtc
	 
	 http://www.nonlinear-labs.de
```

## package/nonlinear/espi_driver/Config.in
```kconfig
config BR2_PACKAGE_ESPI_DRIVER
       bool "espi_driver"
       depends on BR2_LINUX_KERNEL
       help
         NonlinearLabs kernel module for espi hub
	 
	 http://www.nonlinearlabs.de
```

## package/nonlinear/gwt/Config.in
```kconfig
config BR2_PACKAGE_GWT
       bool "GWT compiler"
       help
         the Google Web Toolkit
	 
	 http://www.gwtproject.org
```

## package/nonlinear/hw_tests/nl_emphase/Config.in
```kconfig
config BR2_PACKAGE_HWTESTS_NL_EMPHASE
       bool "nl_emphase"
       help
         Old hardwaretests might be usefull sometimes
	 
	 http://www.nonlinearlabs.de
```

## package/nonlinear/hw_tests/scsx/Config.in
```kconfig
config BR2_PACKAGE_HWTESTS_SCSX
       bool "scsx"
       help
         Hardware test project for SCSX
	 
	 http://www.nonlinearlabs.de
```

## package/nonlinear/libnlaudiocontrol/Config.in
```kconfig
config BR2_PACKAGE_LIBNLAUDIOCONTROL
       bool "libnlaudiocontrol"
       help
         NonlinearLabs library for communication between BB to LPC
	 
	 http://www.nonlinearlabs.de
```

## package/nonlinear/libnlemphase/Config.in
```kconfig
config BR2_PACKAGE_LIBNLEMPHASE
       bool "libnlemphase"
       help
         NonlinearLabs library for supporting nl displays
	 
	 http://www.nonlinearlabs.de
```

## package/nonlinear/libnlfonts/Config.in
```kconfig
config BR2_PACKAGE_LIBNLFONTS
	bool "libnlfonts"
	depends on BR2_PACKAGE_FONTBUILDER 
	help
	  Installs libnlfonts.so with all generated fonts from the bmps in font repository

	  http//www.nonlinear-labs.de
```

## package/nonlinear/libtests/Config.in
```kconfig
config BR2_PACKAGE_LIBTESTS
	bool "libtests"
	#depends on LIBNLEMPHASE
	#depends on LIBNLAUDIOCONTROL	
	help
	  NonlinearLabs libtests, to test nonlinear labs libraries,
	  such as libnlemphase and libnlaudiocontrol

	  http://www.nonlinearlabs.de
```

## package/nonlinear/lpc_bb_driver/Config.in
```kconfig
config BR2_PACKAGE_LPC_BB_DRIVER
       bool "lpc_bb_driver"
       depends on BR2_LINUX_KERNEL
       help
         NonlinearLabs kernel module for communication with lpc
	 
	 http://www.nonlinearlabs.de
```

## package/nonlinear/mxli/Config.in
```kconfig
config BR2_PACKAGE_MXLI
       bool "mxli"
       help
         the MXLI tool for flashing LPC via USB
	 
	 http://www.nonlinear-labs.de
```

## package/nonlinear/nonlinear_all/Config.in
```kconfig
config BR2_PACKAGE_NONLINEAR_ALL
       bool "nonlinear_all"
       help
         meta project for rebuilding all software modules maintained by nonlinear labs team
	 
	 http://www.nonlinear-labs.de
```

## package/nonlinear/nonlinear_dts/Config.in
```kconfig
menuconfig BR2_PACKAGE_NONLINEAR_DTS
	bool "nonlinear-dts"
	depends on BR2_arm
	help
	  Pulls the DTS files from our git repository and compiles them.

	  http://www.nonlinear-labs.de/

if BR2_PACKAGE_NONLINEAR_DTS

config BR2_PACKAGE_NONLINEAR_DTS_REPOSITORY
        string "git repository that holds the dts files"
        default "git@nonlinear-labs.git.beanstalkapp.com:/nonlinear-labs/dts.git"

config BR2_PACKAGE_NONLINEAR_DTS_VERSION
        string "version or branch to check out from the git repository"
        default "master"

endif
```

## package/nonlinear/nonlinear_usb_dts/Config.in
```kconfig
menuconfig BR2_PACKAGE_NONLINEAR_USB_DTS
        bool "nonlinear-usb-dts"
	depends on BR2_arm
        help
          Pulls the DTS files from our git repository and compiles them. Deploys the files under BINARIES_DIR

	  http://www.nonlinear-labs.de/

if BR2_PACKAGE_NONLINEAR_USB_DTS

config BR2_PACKAGE_NONLINEAR_USB_DTS_REPOSITORY
        string "git repository that holds the dts files"
        default "git@github.com:nonlinear-labs-dev/dts.git"

config BR2_PACKAGE_NONLINEAR_USB_DTS_VERSION
        string "version or branch to check out from the git repository"
        default "master"

endif
```

## package/nonlinear/phyreg/Config.in
```kconfig
config BR2_PACKAGE_PHYREG
       bool "phyreg"
       help
         check PHY register if Ethernet is dead or alive - https://github.com/bigjosh/phyreg
	 
	 http://www.nonlinear-labs.de
```

## package/nonlinear/playcontroller_driver/Config.in
```kconfig
config BR2_PACKAGE_PLAYCONTROLLER_DRIVER
       bool "playcontroller_driver"
       depends on BR2_LINUX_KERNEL
       help
         NonlinearLabs kernel module for communication with playcontroller
	 
	 http://www.nonlinearlabs.de
```

## package/nonlinear/playground/Config.in
```kconfig
config BR2_PACKAGE_PLAYGROUND
       bool "playground"
       depends on BR2_PACKAGE_GWT
       help
         the NonlinearLabs playground project
	 
	 http://www.nonlinear-labs.de
```

## package/nonlinear/testrunner/Config.in
```kconfig
config BR2_PACKAGE_TESTRUNNER
       bool "testrunner"
       depends on BR2_LINUX_KERNEL
       help
         NonlinearLabs testrunner, to test hw pins and device files
	 
	 http://www.nonlinearlabs.de
```

## package/nonlinear/text2soled/Config.in
```kconfig
config BR2_PACKAGE_TEXT2SOLED
       bool "text2soled"
       help
         the NonlinearLabs tool for showing text on small OLED
	 
	 http://www.nonlinear-labs.de
```
